//Gesture Recognition code for 2 IR sets 30/3/19
//Michael Mc Ferran
//working wave functions with play/pause when hand above both IR
//version 3.8 with 2 IR Led arrays and leds to indicate switching, working wave gestures forward/rewind function
//working volume up/down


const int pinRX1 = A1; //IR receiver diode for left IR set
const int pinRX2 = A2; //IR receiver diode for right IR set

int ledPin1 = 5;        // used to be 22 declaring and initializing a variable   ledPin1 for output port;
int ledPin2 = 7; // second set
int delay_ms = 50;  // declaring and initializing a variable  delay_ms  for delay;
int delay_av = 30;   //delay used in averaging procedure and getting an ambient light reading. 
// for fast boards it should be set to lower value, e.g. 10 or smaller


int greenLed =10; 
int redLed = 11;
int blueLed = 12;
int switch1 = 0; //LEFT IR ONLY
int switch2 = 0; //BOTH IR
int switch3 = 0; // RIGHT IR ONLY
int switch5 = 0; //BOTH IR but for play/pause
//int switch6 = 0; //used for volume up
//int switch7 = 0;// used for volume down

void setup() {
  //runs once when you press reset or power the board
  // initialize digital pin ledPin as an output.

  Serial.begin(9600);
  pinMode(ledPin1, OUTPUT);    // IR LED pins for left IR
  pinMode(pinRX1, INPUT);      // analog-in pin for left IR
  pinMode(ledPin2, OUTPUT);    // IR LED pins for right IR
  pinMode(pinRX2, INPUT);      // analog-in pin for right IR

  pinMode(greenLed, OUTPUT); //green led
  pinMode(redLed, OUTPUT); //red led
  pinMode(blueLed, OUTPUT); //blue led
}



void loop() {


int Nav =5;  // number of samples used for averaging 
int valueIR1[5];  // values of voltage "read" by the IR receiver     

int ambientIR1 = 0; // signal magnitude  generated by an ambient IR 
int targetIR1 = 0;  // signal magnitude generated by reflection from target
int distL = 0; // distance to target
int calib1 = 60;         // distance calibration parameter originally 100


int valueIR2[5];  // values of voltage "read" by the IR receiver     

int ambientIR2 = 0; // signal magnitude  generated by an ambient IR 
int targetIR2 = 0;  // signal magnitude generated by reflection from target
int distR = 0; // distance to target
int calib2 = 56;         // 56 distance calibration parameter difference of 4 from cailbrated 1




 for(int i=0;i<Nav;i++){ valueIR1[i] = 0; valueIR2[i] = 0;}  // initialize with 0



                   // storing IR coming from the ambient
    
for(int i=0;i<Nav;i++){  
  

digitalWrite(ledPin1,LOW);                            // turning the IR LEDs on to read the IR coming from the target
 
digitalWrite(ledPin2,LOW);  
 
 delay(delay_av);                                             // minimum delay necessary to read values
 ambientIR1 = analogRead(pinRX1);  // storing IR coming from the obstacle
 ambientIR2 = analogRead(pinRX2);

digitalWrite(ledPin1,HIGH);  
digitalWrite(ledPin2,HIGH);   // turning the IR LEDs off to read the IR coming from the ambient

delay(delay_av);                                            // minimum delay necessary to read values
    
targetIR1 = analogRead(pinRX1);   
targetIR2 = analogRead(pinRX2);  

 valueIR1[i] = ambientIR1-targetIR1;   // calculating changes in IR values and storing it for future average
 valueIR2[i] = ambientIR2-targetIR2;
}







 
for(int i=0; i<Nav; i++){        // calculating the average based on the "accuracy"
    
     distL = distL + valueIR1[i];

     distR = distR + valueIR2[i];
  }

distL = distL/Nav;    //averaging
distR = distR/Nav;   

distL = calib1 - distL;  // when target is close, ambientIR-targetIR is maximal
                                              // so the actual distance is calib - distanceTotarget 
                                              // to find calib value, bring the target as close to the
                                              // IR receiver as possible and record the value from the 
                                              // serial monitor 

distR = calib2 - distR;

//declaring different hand wave states

//hand above left IR
if ( (distL<50)&&(distR>70) ) {switch1 =1;} //1 meaning hand above left

//hand above both
if ( (distL<50)&&(distR<50) ) {switch2 =2;} //2 represents hand above both

//hand above neither 
if ( (distL>70)&&(distR>70) ) {switch1 = 4, switch2 = 4, switch3 = 4, switch5 = 4;} 
//4 means off 

//hand above right IR
if ( (distL>70)&&(distR<50) ) {switch3 =3;} //3 meaning hand above right



//play/pause only hand slightly higher above both
if ( (distL>55)&&(distR>55) && (distL<68)&&(distR<68)){switch5 = 5;}
//5 represents hand above both at higher position

           
                    
                    //IR Gestures

//hand above left first
int increment = 0;
while (increment < 1){ //allows value to reset
increment++;
//  Serial.println(distL,DEC);
//  Serial.println("\t"); 
//  Serial.println("right");
//  Serial.println(distR,DEC); 

if (switch1 ==1) { 
  digitalWrite(greenLed, HIGH);
  delay (200); 

 
      //Wave left to right,
      //same as Ctrl+right on keyboard
      //hand is now above both
      if (switch1==1 && switch2==2) {
            
          digitalWrite(greenLed, HIGH);
          digitalWrite(redLed, HIGH); 
          //hand swiped right
          {Serial.println
          ("Fast Forward"); 
           delay (300);}  
           Serial.print("\t"); 
         }
         
        //volume Up by raising hand
       if ((distL>55) && (distR>70)) {                                              
      
      digitalWrite(greenLed, HIGH);
      delay(50);
      digitalWrite(greenLed, LOW);
      digitalWrite(redLed, HIGH);
      delay(50);
      digitalWrite(redLed, LOW);
      digitalWrite(blueLed, HIGH);
      delay(50);
      {Serial.println ("Increase Volume"); delay (300);}
       }
          //Volume down
         if ((distL<45) && (distR>75)) {//Hand lowered to decrease volume, 75 as max ambient is 78-79
      
      digitalWrite(blueLed, HIGH);
      delay(50);
      digitalWrite(blueLed, LOW);
      digitalWrite(redLed, HIGH);
      delay(50);
      digitalWrite(redLed, LOW);
      digitalWrite(greenLed, HIGH);
      delay(50);
      {Serial.println ("Decrease Volume"); delay (300);}
         }
    }
}


 
  //Wave right to left, same as ctrl+left on keyboard
// hand above right first
if (switch3 ==3){
digitalWrite(blueLed, HIGH); 
delay (200); //to show right IR is working



         //detects the hand now above both
           if (switch3==3 && switch2==2) {
             
             digitalWrite(blueLed, HIGH);
             digitalWrite(redLed, HIGH); 
              //hand swiped left
             {Serial.println ("Rewind"); delay (300);}  
            }
}


//Play/Pause when hand above both IR and puts red led on, currently works by not using switch 5


  if (switch5==5) {

   digitalWrite(redLed, HIGH);
   {Serial.println("Play Or Pause"); delay (500);}
   delay(200); //???
  } 
       

// turns LEDS off when hand removed
else   (switch1==4 && switch2==4 && switch3==4 && switch5==4); //added in switch 5
  {
     digitalWrite(greenLed,LOW);
      digitalWrite (redLed,LOW);
      digitalWrite (blueLed,LOW);
     //Serial.println ("Hand removed");
     }            


//Volume Control by lifting hand and moving up for volume up, down for volume down with hand above left IR, can't do both 
//as range taken up by play/pause and hand above both for waves as well

   
//serial monitoring in python
//Serial.println("initial distance of left IR");
//Serial.println(distL,DEC); //to check if IR1 is working correctly
//Serial.println("initial distance of right IR"); 
//Serial.println(distR,DEC); //to check if IR1 is working correctly

//only used for Arduino Serial monitor checking/calibrating values

//Serial.print(distL,DEC); 
//Serial.print("\t"); 
//Serial.print(distR,DEC); 
//Serial.print("\t"); 
//Serial.print(switch1,DEC); 
//
//Serial.println(" "); 
}
 
